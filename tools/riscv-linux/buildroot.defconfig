## tools/riscv-linux/buildroot.defconfig
```kconfig
BR2_riscv=y
BR2_riscv_custom=y
BR2_RISCV_64=y
BR2_RISCV_USE_MMU=y
BR2_RISCV_ISA_RVM=y
BR2_RISCV_ISA_RVA=y
BR2_RISCV_ISA_RVC=y
BR2_RISCV_ABI_LP64=y
BR2_TOOLCHAIN_BUILDROOT_MUSL=y
BR2_STATIC_LIBS=y
BR2_INIT_BUSYBOX=y
BR2_TARGET_ROOTFS_CPIO=y
BR2_TARGET_ROOTFS_CPIO_NONE=y
BR2_REPRODUCIBLE=y
BR2_ROOTFS_OVERLAY="$(HESPER_RISCV_PROFILE)/rootfs"
# BR2_TARGET_ROOTFS_TAR is not set
```
